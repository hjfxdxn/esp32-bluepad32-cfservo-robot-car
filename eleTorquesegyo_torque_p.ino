#include <Bluepad32.h>
#include <SCServo.h>

CFSCL cfscl;

// ======================================================
// Servo Settings
// Servo bus and wheel servo IDs.
// ======================================================

#define S_RXD 18
#define S_TXD 19

const byte LEFT_WHEEL_ID = 1;
const byte RIGHT_WHEEL_ID = 2;

// ======================================================
// Control Parameters
// The gamepad sets target wheel speed.
// A P controller converts speed error into torque/current command.
// ======================================================

// Maximum target speed generated by the joystick.
// Start with a small value while testing the robot on a stand.
const int MAX_REF_SPEED = 120;

// Bluepad32 joystick axes are normally around -512 to 512.
const int JOYSTICK_MAX = 512;
const int JOYSTICK_DEADBAND = 35;

// Torque/current command saturation.
// In the original torque example, WriteEle() was limited to +/-1000.
const int MAX_TORQUE_CMD = 1000;

// P gain.
// If the robot is weak or slow, increase this carefully.
// If it oscillates or shakes, decrease this value.
float Kp = 5.0;

// Right motor trim from the previous speed test.
// Tune these if the robot drifts while driving straight.
const float LEFT_SPEED_TRIM = 1.00;
const float RIGHT_SPEED_TRIM = 1.27;

// Stop the robot if no valid controller data is received for this time.
const uint32_t CONTROL_TIMEOUT_MS = 300;

// Serial Monitor feedback interval.
const uint32_t DEBUG_INTERVAL_MS = 100;

ControllerPtr myControllers[BP32_MAX_GAMEPADS];

// Target speeds in logical robot coordinates:
// positive = wheel drives the robot forward.
int leftRefSpeed = 0;
int rightRefSpeed = 0;

// Measured speeds in logical robot coordinates:
// positive = wheel is moving the robot forward.
int leftActSpeed = 0;
int rightActSpeed = 0;

int leftTorqueCmd = 0;
int rightTorqueCmd = 0;

uint32_t lastControlMs = 0;
uint32_t lastDebugMs = 0;

// ======================================================
// Helper Functions
// ======================================================

int applyDeadband(int value)
{
  if (abs(value) < JOYSTICK_DEADBAND) {
    return 0;
  }

  return constrain(value, -JOYSTICK_MAX, JOYSTICK_MAX);
}

int joystickToSpeed(int value)
{
  value = applyDeadband(value);
  return map(value, -JOYSTICK_MAX, JOYSTICK_MAX, -MAX_REF_SPEED, MAX_REF_SPEED);
}

int saturateTorque(int torqueCmd)
{
  if (torqueCmd > MAX_TORQUE_CMD) {
    return MAX_TORQUE_CMD;
  }

  if (torqueCmd < -MAX_TORQUE_CMD) {
    return -MAX_TORQUE_CMD;
  }

  return torqueCmd;
}

void stopCar()
{
  leftRefSpeed = 0;
  rightRefSpeed = 0;
  leftTorqueCmd = 0;
  rightTorqueCmd = 0;

  cfscl.WriteEle(LEFT_WHEEL_ID, 0);
  cfscl.WriteEle(RIGHT_WHEEL_ID, 0);
}

// ======================================================
// Feedback
// Read actual speed from each servo.
// ======================================================

void readWheelFeedback()
{
  if (cfscl.FeedBack(LEFT_WHEEL_ID) != -1) {
    leftActSpeed = (int16_t)cfscl.ReadSpeed(-1);
  }

  if (cfscl.FeedBack(RIGHT_WHEEL_ID) != -1) {
    // The right wheel is mounted opposite to the left wheel.
    // Convert raw servo speed back to logical robot speed.
    rightActSpeed = -(int16_t)cfscl.ReadSpeed(-1);
  }
}

// ======================================================
// P Controller
// Same structure as the original eleTorquesegyo.ino:
// torqueCmd = Kp * (refSpeed - actSpeed)
// ======================================================

void updateTorqueController()
{
  int leftError = leftRefSpeed - leftActSpeed;
  int rightError = rightRefSpeed - rightActSpeed;

  leftTorqueCmd = saturateTorque((int)(Kp * leftError));
  rightTorqueCmd = saturateTorque((int)(Kp * rightError));
}

// ======================================================
// Send torque command
// WriteEle() sends electric current / torque commands.
// ======================================================

void sendTorqueCommands()
{
  cfscl.WriteEle(LEFT_WHEEL_ID, leftTorqueCmd);

  // The right wheel is mounted opposite to the left wheel, so the logical
  // torque command must be inverted before sending it to the servo.
  cfscl.WriteEle(RIGHT_WHEEL_ID, -rightTorqueCmd);
}

// ======================================================
// Bluepad32 Callbacks
// ======================================================

void onConnectedController(ControllerPtr ctl)
{
  for (int i = 0; i < BP32_MAX_GAMEPADS; i++) {
    if (myControllers[i] == nullptr) {
      myControllers[i] = ctl;
      ControllerProperties properties = ctl->getProperties();

      Serial.printf("Controller connected: slot=%d, model=%s, VID=0x%04x, PID=0x%04x\n",
                    i,
                    ctl->getModelName().c_str(),
                    properties.vendor_id,
                    properties.product_id);
      return;
    }
  }

  Serial.println("Controller connected, but no empty slot is available.");
}

void onDisconnectedController(ControllerPtr ctl)
{
  for (int i = 0; i < BP32_MAX_GAMEPADS; i++) {
    if (myControllers[i] == ctl) {
      myControllers[i] = nullptr;
      stopCar();
      Serial.printf("Controller disconnected: slot=%d\n", i);
      return;
    }
  }
}

ControllerPtr getActiveGamepad()
{
  for (int i = 0; i < BP32_MAX_GAMEPADS; i++) {
    ControllerPtr ctl = myControllers[i];

    if (ctl && ctl->isConnected() && ctl->hasData() && ctl->isGamepad()) {
      return ctl;
    }
  }

  return nullptr;
}

// ======================================================
// Gamepad Processing
// Left stick sets target speed for the P controller.
// ======================================================

void updateTargetSpeedFromGamepad(ControllerPtr ctl)
{
  // Bluepad32 usually reports left-stick up as negative Y.
  int forward = joystickToSpeed(-ctl->axisY());
  int turn = joystickToSpeed(ctl->axisX());

  int leftLogicalSpeed = constrain(forward + turn, -MAX_REF_SPEED, MAX_REF_SPEED);
  int rightLogicalSpeed = constrain(forward - turn, -MAX_REF_SPEED, MAX_REF_SPEED);

  leftRefSpeed = constrain((int)(leftLogicalSpeed * LEFT_SPEED_TRIM),
                           -MAX_REF_SPEED,
                           MAX_REF_SPEED);
  rightRefSpeed = constrain((int)(rightLogicalSpeed * RIGHT_SPEED_TRIM),
                            -MAX_REF_SPEED,
                            MAX_REF_SPEED);

  lastControlMs = millis();
}

// ======================================================
// Serial Plotter / Serial Monitor
// Prints reference speed, actual speed, and torque command.
// ======================================================

void printDebug(ControllerPtr ctl)
{
  if (millis() - lastDebugMs < DEBUG_INTERVAL_MS) {
    return;
  }

  if (ctl) {
    Serial.printf("LX=%4d LY=%4d  Lref=%4d Lact=%4d Ltq=%5d  Rref=%4d Ract=%4d Rtq=%5d\n",
                  ctl->axisX(),
                  ctl->axisY(),
                  leftRefSpeed,
                  leftActSpeed,
                  leftTorqueCmd,
                  rightRefSpeed,
                  rightActSpeed,
                  rightTorqueCmd);
  } else {
    Serial.printf("No controller  Lref=%4d Lact=%4d Ltq=%5d  Rref=%4d Ract=%4d Rtq=%5d\n",
                  leftRefSpeed,
                  leftActSpeed,
                  leftTorqueCmd,
                  rightRefSpeed,
                  rightActSpeed,
                  rightTorqueCmd);
  }

  lastDebugMs = millis();
}

// ======================================================
// Serial Commands
// f: forget Bluetooth pairing keys, then press EN to restart and pair again.
// e: enable new Bluetooth connections.
// s: stop the robot immediately.
// ======================================================

void handleSerialCommands()
{
  if (!Serial.available()) {
    return;
  }

  char command = Serial.read();

  switch (command) {
    case 'f':
    case 'F':
      stopCar();
      Serial.println("Forgetting stored Bluetooth pairing keys.");
      Serial.println("After this message, press EN to restart, then pair the controller again.");
      BP32.forgetBluetoothKeys();
      BP32.enableNewBluetoothConnections(true);
      break;

    case 'e':
    case 'E':
      BP32.enableNewBluetoothConnections(true);
      Serial.println("New Bluetooth connections enabled. Put the controller in pairing mode.");
      break;

    case 's':
    case 'S':
      stopCar();
      Serial.println("Manual stop command received.");
      break;
  }
}

// ======================================================
// Setup
// ======================================================

void setup()
{
  Serial.begin(115200);

  // ESP32 UART connected to the CFServo bus.
  Serial1.begin(1000000, SERIAL_8N1, S_RXD, S_TXD);
  cfscl.pSerial = &Serial1;

  delay(1000);

  // ==========================================
  // Electric Current / Torque Mode
  // Put both wheel servos into EleMode.
  // ==========================================

  cfscl.EleMode(LEFT_WHEEL_ID);
  delay(500);
  cfscl.EleMode(RIGHT_WHEEL_ID);
  delay(500);

  stopCar();

  BP32.setup(&onConnectedController, &onDisconnectedController);
  BP32.enableVirtualDevice(false);
  BP32.enableNewBluetoothConnections(true);

  Serial.println();
  Serial.println("====================================");
  Serial.println("Bluepad32 Torque P Speed Control Ready");
  Serial.println("Pair Xbox / PS5 controller now");
  Serial.println("Left stick sets target wheel speed");
  Serial.println("Serial commands: f=forget pairing keys, e=enable pairing, s=stop");
  Serial.println("Serial baudrate: 115200");
  Serial.println("====================================");
  Serial.println();
}

// ======================================================
// Main Loop
// ======================================================

void loop()
{
  handleSerialCommands();
  BP32.update();

  ControllerPtr ctl = getActiveGamepad();

  if (ctl) {
    updateTargetSpeedFromGamepad(ctl);
  } else if (millis() - lastControlMs > CONTROL_TIMEOUT_MS &&
             (leftRefSpeed != 0 || rightRefSpeed != 0 ||
              leftTorqueCmd != 0 || rightTorqueCmd != 0)) {
    stopCar();
  }

  readWheelFeedback();
  updateTorqueController();
  sendTorqueCommands();
  printDebug(ctl);

  delay(10);
}
